## prj.conf
```kconfig
# Copyright (C) 2023 Alif Semiconductor - All Rights Reserved.
# Use, distribution and modification of this code is permitted under the
# terms stated in the Alif Semiconductor Software License Agreement
#
# You should have received a copy of the Alif Semiconductor Software
# License Agreement with this file. If not, please write to:
# contact@alifsemi.com, or visit: https://alifsemi.com/license
CONFIG_BT=y
CONFIG_BT_CUSTOM=y
CONFIG_ALIF_ROM_LC3_CODEC=y
CONFIG_ALIF_BLE_AUDIO=y

CONFIG_LOG=y
CONFIG_ASSERT=y

CONFIG_PRESENTATION_COMPENSATION_DIRECTION_SINK=y
CONFIG_PRESENTATION_COMPENSATION_CORRECTION_FACTOR=2

# Should be replaced by TRNG when support is available
CONFIG_TEST_RANDOM_GENERATOR=y

# malloc support is required, simplest way is using newlib although it would also be possible to
# configure heap for picolibc
CONFIG_NEWLIB_LIBC=y

# Driver support for audio
CONFIG_I2S=y
CONFIG_I2S_SYNC_BUFFER_FORMAT_SEQUENTIAL=y

# Determine left and right channels by index, not GAF
CONFIG_AUDIO_LOCATION_IMPLICIT=y
```

## overlay-auracast_24_2.conf
```kconfig
# Auracast compliant codec configurations settings - 16KHz, 40 octets per frame, low latency
CONFIG_ALIF_BLE_AUDIO_FS_24KHZ=y
CONFIG_ALIF_BLE_AUDIO_OCTETS_PER_CODEC_FRAME_60=y
CONFIG_ALIF_BLE_AUDIO_RTN_2=y
```

## overlay-dbg.conf
```kconfig
CONFIG_NO_OPTIMIZATIONS=y

# Debug
CONFIG_LOG=y
CONFIG_USE_SEGGER_RTT=y
CONFIG_RTT_CONSOLE=y

CONFIG_MAIN_LOG_LEVEL_DBG=y
CONFIG_BROADCAST_SOURCE_LOG_LEVEL_DBG=y
CONFIG_BLE_AUDIO_LOG_LEVEL_DBG=y
CONFIG_PRESENTATION_COMPENSATION_PRINT_STATS=y


# Debugging configuration
#CONFIG_THREAD_NAME=y
#CONFIG_THREAD_ANALYZER=y
#CONFIG_THREAD_ANALYZER_AUTO=y
#CONFIG_THREAD_ANALYZER_RUN_UNLOCKED=y
#CONFIG_THREAD_ANALYZER_USE_PRINTK=y

# Add asserts
#CONFIG_ASSERT=y
#CONFIG_ASSERT_VERBOSE=y
#CONFIG_ASSERT_NO_COND_INFO=n
#CONFIG_ASSERT_NO_MSG_INFO=n
#CONFIG_THREAD_NAME=y
CONFIG_STACK_SENTINEL=y

#CONFIG_LOG_MODE_IMMEDIATE=y
CONFIG_LOG_MODE_MINIMAL=y
```

## boards/alif_b1_fpga_rtss_he_ble.conf
```kconfig
# Copyright (C) 2023 Alif Semiconductor - All Rights Reserved.
# Use, distribution and modification of this code is permitted under the
# terms stated in the Alif Semiconductor Software License Agreement
#
# You should have received a copy of the Alif Semiconductor Software
# License Agreement with this file. If not, please write to:
# contact@alifsemi.com, or visit: https://alifsemi.com/license

# Audio driver support specific to B1 FPGA board.
# Audio codec is WM8904, connected via I2C.
# Audio clock is provided by SI570, connected via I2C using TCA9548 I2C mux.
CONFIG_I2C=y
CONFIG_WM8904=y
CONFIG_SI570=y

CONFIG_I2C_INIT_PRIORITY=50
CONFIG_I2C_TCA954X_ROOT_INIT_PRIO=51
CONFIG_I2C_TCA954X_CHANNEL_INIT_PRIO=52
CONFIG_WM8904_INIT_PRIORITY=53

# SI570 clock output is passed through a fixed /8 divider to create MCLK signal
CONFIG_AUDIO_CLOCK_DIVIDER=8

# Uses ROM code version 1.2
CONFIG_ALIF_BLE_ROM_IMAGE_V1_2=y

# Debug support
CONFIG_USE_SEGGER_RTT=y
CONFIG_RTT_CONSOLE=y
CONFIG_PRESENTATION_COMPENSATION_PRINT_STATS=y
CONFIG_BROADCAST_SINK_LOG_LEVEL_DBG=y
CONFIG_BLE_AUDIO_LOG_LEVEL_DBG=y
CONFIG_LOG_BUFFER_SIZE=4096
CONFIG_LOG_DEFAULT_LEVEL=3

# Debugging configuration
#CONFIG_THREAD_NAME=y
#CONFIG_THREAD_ANALYZER=y
#CONFIG_THREAD_ANALYZER_AUTO=y
#CONFIG_THREAD_ANALYZER_RUN_UNLOCKED=y
#CONFIG_THREAD_ANALYZER_USE_PRINTK=y

# Add asserts
#CONFIG_ASSERT=y
#CONFIG_ASSERT_VERBOSE=y
#CONFIG_ASSERT_NO_COND_INFO=n
#CONFIG_ASSERT_NO_MSG_INFO=n
#CONFIG_THREAD_NAME=y
#CONFIG_STACK_SENTINEL=y
```

## src/audio_datapath.c
```c
/* Copyright (C) 2023 Alif Semiconductor - All Rights Reserved.
 * Use, distribution and modification of this code is permitted under the
 * terms stated in the Alif Semiconductor Software License Agreement
 *
 * You should have received a copy of the Alif Semiconductor Software
 * License Agreement with this file. If not, please write to:
 * contact@alifsemi.com, or visit: https://alifsemi.com/license
 */

#include <zephyr/logging/log.h>
#include "bluetooth/le_audio/sdu_queue.h"
#include "bluetooth/le_audio/audio_queue.h"
#include "bluetooth/le_audio/iso_datapath_ctoh.h"
#include "bluetooth/le_audio/audio_decoder.h"
#include "bluetooth/le_audio/audio_sink_i2s.h"
#include "bluetooth/le_audio/presentation_compensation.h"
#include "audio_datapath.h"

LOG_MODULE_REGISTER(audio_datapath, CONFIG_BLE_AUDIO_LOG_LEVEL);

#if CONFIG_ALIF_BLE_AUDIO_FRAME_DURATION_10MS
#define FRAMES_PER_SECOND 100
#else
#error "Unsupported configuration"
#endif

#define SDU_QUEUE_LENGTH          4
#define AUDIO_QUEUE_MARGIN_US     20000
#define CHANNEL_COUNT             2
#define AUDIO_BLOCK_SAMPLES       (CONFIG_ALIF_BLE_AUDIO_FS_HZ / FRAMES_PER_SECOND * CHANNEL_COUNT)
#define MIN_PRESENTATION_DELAY_US 30000
#define MICROSECONDS_PER_SECOND   1000000
#define MICROSECONDS_PER_FRAME    MICROSECONDS_PER_SECOND / FRAMES_PER_SECOND

struct audio_datapath {
	struct sdu_queue *sdu_queue_l;
	struct sdu_queue *sdu_queue_r;
	struct iso_datapath_ctoh *iso_dp_l;
	struct iso_datapath_ctoh *iso_dp_r;
	struct audio_queue *audio_queue;
	struct audio_decoder *decoder;
};

K_THREAD_STACK_DEFINE(decoder_stack, CONFIG_LC3_DECODER_STACK_SIZE);

static struct audio_datapath env;
static uint16_t last_sdu;

static void print_sdus(void *context, uint32_t timestamp, uint16_t sdu_seq)
{
	if (last_sdu && (last_sdu + 1 < sdu_seq)) {
		LOG_INF("SDU sequence number jumps, last: %u, now: %u", last_sdu, sdu_seq);
	}
	last_sdu = sdu_seq;

	if (0 == (sdu_seq % 128)) {
		LOG_INF("SDU sequence number %u", sdu_seq);
	}
}

#ifdef CONFIG_PRESENTATION_COMPENSATION_DEBUG
void on_timing_debug_info_ready(struct presentation_comp_debug_data *dbg_data)
{
	LOG_INF("Presentation compensation debug data is ready");
}
#endif

int audio_datapath_create(struct audio_datapath_config *cfg)
{
	if (cfg == NULL) {
		return -EINVAL;
	}

	/* Presentation delay less than a certain value is impossible due to latency of audio
	 * datapath
	 */
	uint32_t pres_delay_us = MAX(cfg->pres_delay_us, MIN_PRESENTATION_DELAY_US);

	env.sdu_queue_l = sdu_queue_create(SDU_QUEUE_LENGTH, cfg->octets_per_frame);
	if (env.sdu_queue_l == NULL) {
		LOG_ERR("Failed to create SDU queue (left)");
		return -ENOMEM;
	}

	/* Stream LID is zero based on the assumption that the left channel is started first, and no
	 * other datapaths are already running concurrently to this module
	 */
	env.iso_dp_l = iso_datapath_ctoh_create(0, env.sdu_queue_l);
	if (env.iso_dp_l == NULL) {
		LOG_ERR("Failed to create ISO datapath (left)");
		return -ENOMEM;
	}

	if (cfg->stereo) {
		env.sdu_queue_r = sdu_queue_create(SDU_QUEUE_LENGTH, cfg->octets_per_frame);
		if (env.sdu_queue_r == NULL) {
			LOG_ERR("Failed to create SDU queue (right)");
			return -ENOMEM;
		}

		/* Stream LID is one based on the assumption that the right channel is started
		 * second, and no other datapaths are already running concurrently to this module
		 */
		env.iso_dp_r = iso_datapath_ctoh_create(1, env.sdu_queue_r);
		if (env.iso_dp_r == NULL) {
			LOG_ERR("Failed to create ISO datapath (right)");
			return -ENOMEM;
		}
	}

	size_t audio_queue_len_us = pres_delay_us + AUDIO_QUEUE_MARGIN_US;
	size_t audio_queue_len_blocks =
		audio_queue_len_us / (MICROSECONDS_PER_SECOND / FRAMES_PER_SECOND);

	env.audio_queue = audio_queue_create(audio_queue_len_blocks, AUDIO_BLOCK_SAMPLES);
	if (env.audio_queue == NULL) {
		LOG_ERR("Failed to create audio queue");
		return -ENOMEM;
	}

	env.decoder = audio_decoder_create(CONFIG_ALIF_BLE_AUDIO_FS_HZ, decoder_stack,
					   CONFIG_LC3_DECODER_STACK_SIZE, env.sdu_queue_l,
					   env.sdu_queue_r, env.audio_queue);

	if (env.decoder == NULL) {
		LOG_ERR("Failed to create audio decoder");
		return -ENOMEM;
	}

	int ret = audio_sink_i2s_configure(cfg->i2s_dev, env.audio_queue,
					   MICROSECONDS_PER_SECOND / MICROSECONDS_PER_FRAME);

	if (ret != 0) {
		LOG_ERR("Failed to configure audio sink I2S, err %d", ret);
		return ret;
	}

	/* TODO: Change MCLK to use alif clock control */

	/* ret = presentation_compensation_configure(cfg->mclk_dev, pres_delay_us);
	 * if (ret != 0) {
	 *	LOG_ERR("Failed to configure presentation compensation module, err %d", ret);
	 *	return ret;
	 * }
	 */

	/* Add presentation compensation callback to notify audio sink */
	/* ret = presentation_compensation_register_cb(audio_sink_i2s_apply_timing_correction);
	 * if (ret != 0) {
	 *	LOG_ERR("Failed to register presentation compensation callback, err %d", ret);
	 *	return ret;
	 * }
	 */

#ifdef CONFIG_PRESENTATION_COMPENSATION_DEBUG
	/* ret = presentation_compensation_register_debug_cb(on_timing_debug_info_ready);
	 * if (ret != 0) {
	 *	LOG_ERR("Failed to register presentation compensation debug callback, err %d", ret);
	 *	return ret;
	 * }
	 */
#endif

	ret = audio_decoder_register_cb(env.decoder, print_sdus, NULL);
	if (ret != 0) {
		LOG_ERR("Failed to register decoder cb, err %d", ret);
		return ret;
	}
	/* Add callback(s) to notify ISO datapath(s) */
	ret = audio_decoder_register_cb(env.decoder, iso_datapath_ctoh_notify_sdu_done,
					env.iso_dp_l);
	if (ret != 0) {
		LOG_ERR("Failed to register decoder cb, err %d", ret);
		return ret;
	}

	if (env.iso_dp_r) {
		ret = audio_decoder_register_cb(env.decoder, iso_datapath_ctoh_notify_sdu_done,
						env.iso_dp_r);
		if (ret != 0) {
			LOG_ERR("Failed to register decoder cb, err %d", ret);
			return ret;
		}
	}

	/* Add a callback to notify audio sink */
	ret = audio_decoder_register_cb(env.decoder, audio_sink_i2s_notify_buffer_available, NULL);
	if (ret != 0) {
		LOG_ERR("Failed to register decoder cb, err %d", ret);
		return ret;
	}

	LOG_INF("Created audio datapath");

	return 0;
}

int audio_datapath_start(void)
{
	/* Notify that first buffer is available to start reception */
	iso_datapath_ctoh_notify_sdu_done(env.iso_dp_l, 0, 0);
	if (env.iso_dp_r) {
		iso_datapath_ctoh_notify_sdu_done(env.iso_dp_r, 0, 0);
	}

	LOG_INF("Audio datapath started");

	return 0;
}

int audio_datapath_cleanup(void)
{
	/* Stop and cleanup decoder thread first as it references other modules */
	if (env.decoder) {
		audio_decoder_delete(env.decoder);
	}

	/* Then delete ISO DP to stop any incoming SDUs */
	if (env.iso_dp_l) {
		iso_datapath_ctoh_delete(env.iso_dp_l);
	}

	if (env.iso_dp_r) {
		iso_datapath_ctoh_delete(env.iso_dp_r);
	}

	/* Then clean up queues */
	if (env.sdu_queue_l) {
		sdu_queue_delete(env.sdu_queue_l);
	}

	if (env.sdu_queue_r) {
		sdu_queue_delete(env.sdu_queue_r);
	}

	if (env.audio_queue) {
		audio_queue_delete(env.audio_queue);
	}

	LOG_INF("Removed audio datapath");

	return 0;
}
```

## src/broadcast_sink.c
```c
/* Copyright (C) 2023 Alif Semiconductor - All Rights Reserved.
 * Use, distribution and modification of this code is permitted under the
 * terms stated in the Alif Semiconductor Software License Agreement
 *
 * You should have received a copy of the Alif Semiconductor Software
 * License Agreement with this file. If not, please write to:
 * contact@alifsemi.com, or visit: https://alifsemi.com/license
 */

#include <zephyr/types.h>
#include <zephyr/kernel.h>
#include <zephyr/logging/log.h>
#include <zephyr/init.h>
#include <zephyr/sys/__assert.h>
#include <string.h>
#include "alif_lc3.h"
#include "bap_bc_sink.h"
#include "bap_bc_scan.h"
#include "audio_datapath.h"
#include "broadcast_sink.h"

LOG_MODULE_REGISTER(broadcast_sink, CONFIG_BROADCAST_SINK_LOG_LEVEL);

#define SYNCHRONISATION_TIMEOUT_MS 2000
#define SYNCHRONISATION_TIMEOUT    (SYNCHRONISATION_TIMEOUT_MS / 10)
#define SCAN_TIMEOUT_MS            1000
#define SCAN_TIMEOUT               (SCAN_TIMEOUT_MS / 10)
#define SINK_TIMEOUT_MS            1000
#define SINK_TIMEOUT               (SINK_TIMEOUT_MS / 10)
#define INVALID_CHANNEL_INDEX      0xFF

#define GAF_LOC_LEFT_OR_CENTRE_MASK                                                                \
	(GAF_LOC_FRONT_LEFT_BIT | GAF_LOC_FRONT_LEFT_BIT | GAF_LOC_BACK_LEFT_BIT |                 \
	 GAF_LOC_FRONT_LEFT_CENTER_BIT | GAF_LOC_BACK_CENTER_BIT | GAF_LOC_SIDE_LEFT_BIT |         \
	 GAF_LOC_TOP_FRONT_LEFT_BIT | GAF_LOC_TOP_FRONT_CENTER_BIT | GAF_LOC_TOP_CENTER_BIT |      \
	 GAF_LOC_TOP_BACK_LEFT_BIT | GAF_LOC_TOP_SIDE_LEFT_BIT | GAF_LOC_TOP_BACK_CENTER_BIT |     \
	 GAF_LOC_BOTTOM_FRONT_CENTER_BIT | GAF_LOC_BOTTOM_FRONT_LEFT_BIT |                         \
	 GAF_LOC_FRONT_LEFT_WIDE_BIT | GAF_LOC_LEFT_SURROUND_BIT)
#define GAF_LOC_RIGHT_MASK                                                                         \
	(GAF_LOC_FRONT_RIGHT_BIT | GAF_LOC_BACK_RIGHT_BIT | GAF_LOC_FRONT_RIGHT_CENTER_BIT |       \
	 GAF_LOC_SIDE_RIGHT_BIT | GAF_LOC_TOP_FRONT_RIGHT_BIT | GAF_LOC_TOP_BACK_RIGHT_BIT |       \
	 GAF_LOC_TOP_SIDE_RIGHT_BIT | GAF_LOC_BOTTOM_FRONT_RIGHT_BIT |                             \
	 GAF_LOC_FRONT_RIGHT_WIDE_BIT)

/* Configuration obtained from advertising reports */
struct broadcast_sink_env {
	/* Details of PA, group etc. to enable */
	bap_bcast_id_t bcast_id;
	uint32_t chosen_streams_bf;
	uint32_t started_streams_bf;
	uint8_t left_channel_pos;
	uint8_t right_channel_pos;
	uint8_t pa_lid;
	uint8_t grp_lid;

	/* Audio datapath configuration */
	struct audio_datapath_config datapath_cfg;
	bool datapath_cfg_valid;
};

#define I2S_NODE      DT_ALIAS(i2s_bus)
#define CODEC_NODE    DT_ALIAS(audio_codec)
/* #define MCLK_GEN_NODE DT_ALIAS(mclk_gen) */

BUILD_ASSERT(!DT_PROP(I2S_NODE, mono_mode), "I2S must be configured in stereo mode");

const struct device *i2s_dev = DEVICE_DT_GET(I2S_NODE);
const struct device *codec_dev = DEVICE_DT_GET(CODEC_NODE);
/* const struct device *mclk_gen_dev = DEVICE_DT_GET(MCLK_GEN_NODE); */

static uint8_t expected_streams;
static bool public_broadcast_found;
static struct broadcast_sink_env sink_env;

/* Initialisation to perform pre-main */
static int broadcast_sink_init(void)
{
	int ret = alif_lc3_init();

	__ASSERT(ret == 0, "Failed to initialise LC3 codec");

	/* Check all devices are ready */
	__ASSERT(device_is_ready(i2s_dev), "I2S is not ready");
	__ASSERT(device_is_ready(codec_dev), "Audio codec is not ready");
	/* __ASSERT(device_is_ready(mclk_gen_dev), "MCLK device is not ready"); */

	return ret;
}
SYS_INIT(broadcast_sink_init, APPLICATION, 0);

static void reset_sink_config(void)
{
	/* Assume config is OK to start, and set false if anything incompatible is found */
	memset(&sink_env, 0, sizeof(sink_env));
	sink_env.datapath_cfg_valid = true;
	sink_env.datapath_cfg.i2s_dev = i2s_dev;
	/* sink_env.datapath_cfg.mclk_dev = mclk_gen_dev; */
	sink_env.right_channel_pos = INVALID_CHANNEL_INDEX;
	sink_env.left_channel_pos = INVALID_CHANNEL_INDEX;
}

static int start_scanning(void)
{
	LOG_INF("Start scanning for broadcast sources");

	/* Zero timeout value causes it to scan until explicitly stopped */
	uint16_t err = bap_bc_scan_start(0);

	if (err != GAP_ERR_NO_ERROR) {
		LOG_ERR("Failed to start bap_bc_scan, err %u", err);
		return -ENODEV;
	}

	reset_sink_config();
	public_broadcast_found = false;

	return 0;
}

static int sink_enable(void)
{
	if (!sink_env.datapath_cfg_valid) {
		LOG_ERR("Cannot enable sink for invalid config");
		return -1;
	}

	if (sink_env.left_channel_pos != INVALID_CHANNEL_INDEX) {
		sink_env.chosen_streams_bf |= (1U << (sink_env.left_channel_pos - 1));
	}

	if (sink_env.right_channel_pos != INVALID_CHANNEL_INDEX) {
		sink_env.chosen_streams_bf |= (1U << (sink_env.right_channel_pos - 1));
	}

	LOG_INF("Chosen streams bitfield: %x", sink_env.chosen_streams_bf);

	uint16_t err =
		bap_bc_sink_enable(sink_env.pa_lid, &sink_env.bcast_id, sink_env.chosen_streams_bf,
				   NULL, 0, SINK_TIMEOUT, &sink_env.grp_lid);

	if (err) {
		LOG_ERR("Failed to enable bap_bc_sink, err %u", err);
		return -1;
	}

	return 0;
}

static void terminate_pa_sync(void)
{
	uint16_t err = bap_bc_scan_pa_terminate(sink_env.pa_lid);

	if (err) {
		LOG_ERR("Failed to terminate sync with PA, err %u", err);
	}
}

static int start_streaming(void)
{
	gaf_codec_id_t codec_id = GAF_CODEC_ID_LC3;

	uint16_t err = bap_bc_sink_start_streaming(sink_env.grp_lid, sink_env.left_channel_pos,
						   &codec_id, GAPI_DP_ISOOSHM, 0, NULL);

	if (err) {
		LOG_ERR("Failed to start streaming with err %u", err);
		start_scanning();
		return -1;
	}

	if (sink_env.right_channel_pos != INVALID_CHANNEL_INDEX) {
		uint16_t err =
			bap_bc_sink_start_streaming(sink_env.grp_lid, sink_env.right_channel_pos,
						    &codec_id, GAPI_DP_ISOOSHM, 0, NULL);

		if (err) {
			LOG_ERR("Failed to start streaming with err %u", err);
			start_scanning();
			return -1;
		}
	}

	return 0;
}

static void on_bap_bc_scan_cmp_evt(uint8_t cmd_type, uint16_t status, uint8_t pa_lid)
{
	switch (cmd_type) {
	case BAP_BC_SCAN_CMD_TYPE_START:
		LOG_INF("Scan start cmd complete, status %u", status);
		break;
	case BAP_BC_SCAN_CMD_TYPE_STOP:
		LOG_INF("Scan stop cmd complete, status %u", status);
		break;
	case BAP_BC_SCAN_CMD_TYPE_PA_SYNCHRONIZE:
		LOG_INF("PA synchronise cmd complete, status %u", status);
		break;
	case BAP_BC_SCAN_CMD_TYPE_PA_TERMINATE:
		LOG_INF("PA terminate cmd complete, status %u", status);
		break;
	default:
		LOG_INF("Unexpected cmd_type %u", cmd_type);
		break;
	}
}

static void on_bap_bc_scan_timeout(void)
{
	LOG_INF("scan timeout");
}

static void on_bap_bc_scan_report(const bap_adv_id_t *p_adv_id, const bap_bcast_id_t *p_bcast_id,
				  uint8_t info_bf, const gaf_adv_report_air_info_t *p_air_info,
				  uint16_t length, const uint8_t *p_data)
{
	LOG_INF("Got scan report");
	LOG_INF("Public Broadcast Profile %s supported",
		(info_bf & BAP_BC_SCAN_PUBLIC_BROADCAST_SUPPORT_BIT) ? "is" : "is not");
	LOG_INF("Broadcast ID: %02x %02x %02x", p_bcast_id->id[0], p_bcast_id->id[1],
		p_bcast_id->id[2]);
	LOG_INF("Air info: tx_pwr %u, rssi %u", p_air_info->tx_pwr, p_air_info->rssi);
	LOG_HEXDUMP_DBG(p_data, length, "adv data: ");

	/* Store broadcast ID for later */
	memcpy(&sink_env.bcast_id, p_bcast_id, sizeof(bap_bcast_id_t));
}

static void on_bap_bc_scan_public_bcast(const bap_adv_id_t *p_adv_id,
					const bap_bcast_id_t *p_bcast_id, uint8_t pbp_features_bf,
					uint8_t broadcast_name_len, const uint8_t *p_broadcast_name,
					uint8_t metadata_len, const uint8_t *p_metadata)
{
	bool correct_stream = false;

	LOG_INF("Got public broadcast report");
	LOG_INF("PBP features: encrypted: %s, standard quality: %s, high quality: %s",
		(pbp_features_bf & BAP_BC_PBP_FEATURES_ENCRYPTED_BIT) ? "yes" : "no",
		(pbp_features_bf & BAP_BC_PBP_FEATURES_STANDARD_QUALITY_PRESENT_BIT) ? "yes" : "no",
		(pbp_features_bf & BAP_BC_PBP_FEATURES_HIGH_QUALITY_PRESENT_BIT) ? "yes" : "no");
	if (broadcast_name_len < 20) {
		char broadcast_name[20];

		memcpy(broadcast_name, p_broadcast_name, broadcast_name_len);
		broadcast_name[broadcast_name_len] = '\0';
		LOG_INF("Broadcast name %s", broadcast_name);

		correct_stream = (0 == memcmp(CONFIG_BROADCAST_NAME, broadcast_name,
				  broadcast_name_len));
	}
	LOG_HEXDUMP_DBG(p_metadata, metadata_len, "metadata: ");

	/* If we found a non-encrypted public broadcast, synchronise to this */
	if (correct_stream && !(pbp_features_bf & BAP_BC_PBP_FEATURES_ENCRYPTED_BIT)
		&& !public_broadcast_found) {
		LOG_INF("Synchronising to public broadcast");
		public_broadcast_found = true;

		uint16_t err = bap_bc_scan_pa_synchronize(p_adv_id, 0, BAP_BC_SCAN_REPORT_MASK,
							  SYNCHRONISATION_TIMEOUT, SCAN_TIMEOUT,
							  &sink_env.pa_lid);

		if (err != GAP_ERR_NO_ERROR) {
			LOG_ERR("Failed to start PA synchronise procedure, err %u", err);
		}
	}
}

static void on_bap_bc_scan_pa_established(uint8_t pa_lid, const bap_adv_id_t *p_adv_id, uint8_t phy,
					  uint16_t interval_frames)
{
	LOG_INF("PA synchronised, pa_lid %u interval %u ms", pa_lid, (interval_frames * 5) / 4);

	uint16_t err = bap_bc_scan_stop();

	if (err) {
		LOG_INF("Failed to stop scanning, err %u", err);
	}
}

static void on_bap_bc_scan_pa_terminated(uint8_t pa_lid, uint8_t reason)
{
	LOG_INF("PA desynchronised, reason %u", reason);
}

static void on_bap_bc_scan_pa_report(uint8_t pa_lid, const gaf_adv_report_air_info_t *p_air_info,
				     uint16_t length, const uint8_t *p_data)
{
	LOG_INF("PA report");
	LOG_INF("Air info: tx_pwr %u rssi %u", p_air_info->tx_pwr, p_air_info->rssi);
	LOG_HEXDUMP_DBG(p_data, length, "periodic adv data: ");
}

static void on_bap_bc_scan_big_info_report(uint8_t pa_lid, const gapm_le_big_info_t *p_report)
{
	LOG_INF("BIGinfo report");
	LOG_INF("SDU interval %u us, ISO interval %u ms, max_pdu %u max_sdu %u",
		p_report->sdu_interval, p_report->iso_interval, p_report->max_pdu,
		p_report->max_sdu);
	LOG_INF("num_bis %u, NSE %u, BN %u, PTO %u, IRC %u, PHY %u, framing %u, encrypted %u",
		p_report->num_bis, p_report->nse, p_report->bn, p_report->pto, p_report->irc,
		p_report->phy, p_report->framing, p_report->encrypted);
}

static void on_bap_bc_scan_group_report(uint8_t pa_lid, uint8_t nb_subgroups, uint8_t nb_streams,
					uint32_t pres_delay_us)
{
	LOG_INF("Group report: %u subgroups, %u streams, presentation delay %u us", nb_subgroups,
		nb_streams, pres_delay_us);
	expected_streams = nb_streams;

	/* Store presentation delay for later use */
	sink_env.datapath_cfg.pres_delay_us = pres_delay_us;
}

static int bap_sampling_freq_from_hz(uint32_t sampling_freq_hz)
{
	switch (sampling_freq_hz) {
	case 8000:
		return BAP_SAMPLING_FREQ_8000HZ;
	case 16000:
		return BAP_SAMPLING_FREQ_16000HZ;
	case 24000:
		return BAP_SAMPLING_FREQ_24000HZ;
	case 32000:
		return BAP_SAMPLING_FREQ_32000HZ;
	case 48000:
		return BAP_SAMPLING_FREQ_48000HZ;
	default:
		return BAP_SAMPLING_FREQ_UNKNOWN;
	}
}

static int hz_from_bap_sampling_freq(enum bap_sampling_freq bap_sampling_freq)
{
	switch (bap_sampling_freq) {
	case BAP_SAMPLING_FREQ_8000HZ:
		return 8000;
	case BAP_SAMPLING_FREQ_16000HZ:
		return 16000;
	case BAP_SAMPLING_FREQ_24000HZ:
		return 24000;
	case BAP_SAMPLING_FREQ_32000HZ:
		return 32000;
	case BAP_SAMPLING_FREQ_48000HZ:
		return 48000;
	default:
		return -EINVAL;
	}
}

static void on_bap_bc_scan_subgroup_report(uint8_t pa_lid, uint8_t sgrp_id, uint32_t stream_pos_bf,
					   const gaf_codec_id_t *p_codec_id,
					   const bap_cfg_ptr_t *p_cfg,
					   const bap_cfg_metadata_ptr_t *p_metadata)
{
	LOG_INF("Subgroup report");
	LOG_INF("sgrp_id %u, stream_bf %x, codec_id %02x %02x %02x %02x %02x", sgrp_id,
		stream_pos_bf, p_codec_id->codec_id[0], p_codec_id->codec_id[1],
		p_codec_id->codec_id[2], p_codec_id->codec_id[3], p_codec_id->codec_id[4]);
	LOG_INF("BAP cfg: loc_bf %x frame_octet %u sampling_freq %u frame_dur %u frames_sdu %u",
		p_cfg->param.location_bf, p_cfg->param.frame_octet, p_cfg->param.sampling_freq,
		p_cfg->param.frame_dur, p_cfg->param.frames_sdu);

	/* Validate config is OK and store relevant info for later use */
	if (p_cfg->param.sampling_freq != bap_sampling_freq_from_hz(CONFIG_ALIF_BLE_AUDIO_FS_HZ)) {

		LOG_INF("Sampling frequency is not compatible, need %uHz got %d",
			CONFIG_ALIF_BLE_AUDIO_FS_HZ,
			hz_from_bap_sampling_freq(p_cfg->param.sampling_freq));

		sink_env.datapath_cfg_valid = false;
	}

	if (p_cfg->param.frame_dur != BAP_FRAME_DUR_10MS) {
		LOG_INF("Frame duration is not compatible, need 10 ms");
		sink_env.datapath_cfg_valid = false;
	}

	sink_env.datapath_cfg.octets_per_frame = p_cfg->param.frame_octet;
}

static void assign_audio_channel(uint8_t stream_count, uint8_t stream_pos, uint16_t loc_bf)
{
#ifdef CONFIG_AUDIO_LOCATION_USE_GAF
	if ((loc_bf & GAF_LOC_LEFT_OR_CENTRE_MASK) &&
	    (sink_env.left_channel_pos == INVALID_CHANNEL_INDEX)) {
#else /* CONFIG_AUDIO_LOCATION_IMPLICIT */
	if (stream_count == 0) {
#endif
		LOG_INF("Stream index %u is left or centre channel", stream_pos);
		sink_env.left_channel_pos = stream_pos;
	}

#ifdef CONFIG_AUDIO_LOCATION_USE_GAF
	if ((loc_bf & GAF_LOC_RIGHT_MASK) &&
	    (sink_env.right_channel_pos == INVALID_CHANNEL_INDEX)) {
#else /* CONFIG_AUDIO_LOCATION_IMPLICIT */
	if (stream_count == 1) {
#endif
		LOG_INF("Stream index %u is right channel", stream_pos);
		sink_env.right_channel_pos = stream_pos;
		sink_env.datapath_cfg.stereo = true;
	}
}

static void on_bap_bc_scan_stream_report(uint8_t pa_lid, uint8_t sgrp_id, uint8_t stream_pos,
					 const gaf_codec_id_t *p_codec_id,
					 const bap_cfg_ptr_t *p_cfg)
{
	static uint8_t stream_report_count;

	LOG_INF("Stream report %u", stream_pos);
	LOG_INF("BAP cfg: loc_bf %x frame_octet %u sampling_freq %u frame_dur %u frames_sdu %u",
		p_cfg->param.location_bf, p_cfg->param.frame_octet, p_cfg->param.sampling_freq,
		p_cfg->param.frame_dur, p_cfg->param.frames_sdu);

	assign_audio_channel(stream_report_count, stream_pos, p_cfg->param.location_bf);

	if (++stream_report_count >= expected_streams) {
		expected_streams = 0;
		stream_report_count = 0;

		LOG_INF("Disabling PA reports");
		uint16_t err = bap_bc_scan_pa_report_ctrl(sink_env.pa_lid, 0);

		if (err) {
			LOG_ERR("Failed to disable PA reports");
		}

		if (sink_env.left_channel_pos == INVALID_CHANNEL_INDEX) {
			LOG_INF("A left or centre channel must be present");
			sink_env.datapath_cfg_valid = false;
		}

		if (sink_env.datapath_cfg_valid) {
			LOG_INF("Compatible audio source found");

			/* Enable BC sink for the compatible source */
			sink_enable();
		} else {
			LOG_INF("Audio source is not compatible");

			/* Restart scanning for another source */
			start_scanning();
		}
	}
}

static void on_bap_bc_sink_cmp_evt(uint8_t cmd_type, uint16_t status, uint8_t grp_lid,
				   uint8_t stream_pos)
{
	switch (cmd_type) {
	case BAP_BC_SINK_CMD_TYPE_ENABLE:
		LOG_INF("enable cmd complete, status %u, grp %u, stream %u", status, grp_lid,
			stream_pos);
		break;
	case BAP_BC_SINK_CMD_TYPE_START_STREAMING:
		LOG_INF("start streaming cmd complete, status %u, grp %u, stream %u", status,
			grp_lid, stream_pos);
		sink_env.started_streams_bf |= (1U << (stream_pos - 1));

		/* Start audio datapath when all chosen streams are started */
		if (sink_env.started_streams_bf == sink_env.chosen_streams_bf) {
			int ret = audio_datapath_create(&sink_env.datapath_cfg);

			if (ret) {
				audio_datapath_cleanup();
				LOG_ERR("Failed to create audio datapath");
				start_scanning();
			}

			audio_datapath_start();
		}
		break;
	default:
		LOG_ERR("Unexpected cmd type %u", cmd_type);
		break;
	}
}

static void on_bap_bc_sink_quality_cmp_evt(uint16_t status, uint8_t grp_lid, uint8_t stream_pos,
					   uint32_t crc_error_packets, uint32_t rx_unrx_packets,
					   uint32_t duplicate_packets)
{
	LOG_INF("cb_sink_quality, status %u group %u stream %u crc_err %u missing %u duplicate %u",
		status, grp_lid, stream_pos, crc_error_packets, rx_unrx_packets, duplicate_packets);
}

static void on_bap_bc_sink_status(uint8_t grp_lid, uint8_t state, uint32_t stream_pos_bf,
				  const gapi_bg_sync_config_t *p_bg_cfg, uint8_t nb_bis,
				  const uint16_t *p_conhdl)
{
	switch (state) {
	case BAP_BC_SINK_ESTABLISHED:
		LOG_INF("sync established with group %u", grp_lid);
		terminate_pa_sync();
		start_streaming();
		break;
	case BAP_BC_SINK_FAILED:
	case BAP_BC_SINK_CANCELLED:
	case BAP_BC_SINK_LOST:
	case BAP_BC_SINK_PEER_TERMINATE:
	case BAP_BC_SINK_UPPER_TERMINATE:
	case BAP_BC_SINK_MIC_FAILURE:
		LOG_INF("no sync with group %u, state %u", grp_lid, state);
		audio_datapath_cleanup();
		start_scanning();
		break;
	default:
		LOG_ERR("Unexpected bc_sink state %u", state);
		break;
	}
}

static const bap_bc_scan_cb_t scan_cbs = {
	.cb_cmp_evt = on_bap_bc_scan_cmp_evt,
	.cb_timeout = on_bap_bc_scan_timeout,
	.cb_report = on_bap_bc_scan_report,
	.cb_public_bcast_source = on_bap_bc_scan_public_bcast,
	.cb_pa_established = on_bap_bc_scan_pa_established,
	.cb_pa_terminated = on_bap_bc_scan_pa_terminated,
	.cb_pa_report = on_bap_bc_scan_pa_report,
	.cb_big_info_report = on_bap_bc_scan_big_info_report,
	.cb_group_report = on_bap_bc_scan_group_report,
	.cb_subgroup_report = on_bap_bc_scan_subgroup_report,
	.cb_stream_report = on_bap_bc_scan_stream_report,
};

static const bap_bc_sink_cb_t sink_cbs = {
	.cb_cmp_evt = on_bap_bc_sink_cmp_evt,
	.cb_quality_cmp_evt = on_bap_bc_sink_quality_cmp_evt,
	.cb_status = on_bap_bc_sink_status,
};

int broadcast_sink_start(void)
{
	uint16_t err;

	err = bap_bc_scan_configure(BAP_ROLE_SUPP_BC_SINK_BIT | BAP_ROLE_SUPP_BC_SCAN_BIT,
				    &scan_cbs);
	if (err != GAP_ERR_NO_ERROR) {
		LOG_ERR("Failed to configure bap_bc_scan, err %u", err);
		return -ENODEV;
	}

	err = bap_bc_sink_configure(BAP_ROLE_SUPP_BC_SINK_BIT | BAP_ROLE_SUPP_BC_SCAN_BIT,
				    &sink_cbs);
	if (err != GAP_ERR_NO_ERROR) {
		LOG_ERR("Failed to configure bap_bc_sink, err %u", err);
		return -ENODEV;
	}

	return start_scanning();
}
```
