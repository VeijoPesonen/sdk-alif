## samples/bluetooth/le_audio/broadcast_source/Kconfig
```kconfig
#Copyright(C) 2023 Alif Semiconductor - All Rights Reserved.
#Use, distribution and modification of this code is permitted under the
#terms stated in the Alif Semiconductor Software License Agreement
#
#You should have received a copy of the Alif Semiconductor Software
#License Agreement with this file.If not, please write to:
#contact @alifsemi.com, or visit : https: // alifsemi.com/license

menu "Alif Bluetooth LE Audio Broadcast Source"

config BLE_DEVICE_NAME
	string "BLE device name"
	default "ALIF_ZEPHYR"
	help
	  Device name to be included in advertising packets

config BROADCAST_NAME
	string "LE audio broadcast name"
	default "ALIF_LE_AUDIO"

config BROADCAST_SOURCE_MONO
	bool "Broadcast source mono mode"
	help
		In mono mode the application will only record a single (left) channel from the I2S, encode
		this channel once, but send out the encoded SDUs on both left and right broadcast
		isochronous streams.

		This means that to a sink device it appears as though both left and right channels are
		present, which is sometimes required for compatibility.

		But only one LC3 encoder is needed which saves on memory and runtime, plus this could also
		be useful in a case where the source of the audio data (e.g. microphone) only outputs a
		single channel.

config LE_AUDIO_PRESENTATION_DELAY_MS
	int "Presentation delay in ms"
	default 40
	help
	  LE audio presentation delay in ms. For the audio source use-case, this is defined as the
	  time in ms from the start of recording an audio frame, to the SDU reference anchor point
	  at which the SDU containing the same audio frame is sent over BLE. The absolute minimum
	  possible presentation delay would be the frame length (10 ms) plus the encoding time of
	  the frame, since it is impossible to send the frame before it has been fully recorded and
	  encoded. But some margin should be added on top of this to account for any overhead and
	  timing variations due to other activities of the software occurring while recording and
	  encoding the audio.

choice
	prompt "Choose LE audio max transport latency"
	default LE_AUDIO_MAX_TLATENCY_10
	help
	  The max transport latency effectively specifies the length of time during which an SDU may
	  be retransmitted. A higher value will lead to a large end-to-end audio latency, since the
	  receiver must wait for the last time slot at which the frame can be received before the
	  frame can be rendered (even if it already received an earlier transmission of the frame).
	  But a higher value also results in higher reliability due to the time diversity of frame
	  retransmissions.

	config LE_AUDIO_MAX_TLATENCY_10
	bool "10 ms"
	config LE_AUDIO_MAX_TLATENCY_20
	bool "20 ms"
endchoice

config APP_PRINT_STATS
	bool "Print info about send SDUs"
	depends on LOG

config APP_PRINT_STATS_INTERVAL
	int "Interval for printing info about send frames, in SDU count"
	default 1024
	depends on APP_PRINT_STATS
	help
	  Interval at which to print presentation delay statistics. The interval is measured in SDU
	  count, e.g. 1024 means to print the statistics every 512 SDUs (per channel). With a 10 ms
	  SDU interval this is around 10 seconds.

config LE_AUDIO_MAX_TLATENCY
	int
	default 10 if LE_AUDIO_MAX_TLATENCY_10
	default 20 if LE_AUDIO_MAX_TLATENCY_20

menu "Logging"

module = MAIN
module-str = main
source "subsys/logging/Kconfig.template.log_config"

module = BROADCAST_SOURCE
module-str = broadcast_source
source "subsys/logging/Kconfig.template.log_config"

endmenu # "Logging"

endmenu # "Alif Bluetooth LE Audio Broadcast Source"

source "Kconfig.zephyr"
```
